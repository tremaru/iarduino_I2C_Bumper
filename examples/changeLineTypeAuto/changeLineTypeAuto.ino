// Пример автомотической смены типа линии трассы:          // * Строки со звёздочкой являются необязательными.
                                                           //
#include <Wire.h>                                          // * Подключаем библиотеку для работы с аппаратной шиной I2C.
#include <iarduino_I2C_Bumper.h>                           //   Подключаем библиотеку для работы с бампером I2C-flash.
iarduino_I2C_Bumper bum(0x09);                             //   Объявляем объект bum для работы с функциями и методами библиотеки iarduino_I2C_Bumper, указывая адрес модуля на шине I2C.
                                                           //   Если объявить объект без указания адреса (iarduino_I2C_Bumper bum;), то адрес будет найден автоматически.
void setup(){                                              //
    delay(500);                                            // * Ждём завершение переходных процессов связанных с подачей питания.
    Serial.begin(9600);                                    //   Инициируем передачу данных в монитор последовательного порта на скорости 9600 бит/сек.
    while(!Serial){;}                                      // * Ждём завершения инициализации шины UART.
    bum.begin();                                           //   Инициируем работу с бампером.
}                                                          //
                                                           //
void loop(){                                               //
    uint16_t a;                                            // * Объявляем переменную для получения флагов состояния всех датчиков линий.
//  Меняем тип трассы если изменился цвет линии:           //
    if( bum.getLineSum(a)>4 ){                             //   Если больше 4 датчиков бампера фиксируют линию, то ...
        bum.setLineType(BUM_LINE_CHANGE);                  //   Меняем тип линии трассы.
        a=~a;                                              //   Меняем флаги состояния датчиков бампера.
        Serial.println("Выполнена смена типа трассы.");    //   Выводим текст.
    }                                                      //
//  Выводим номера датчиков под которыми есть линия:       // * 
    if(a){Serial.print("Линия под датчиком:");}            // * Выводим текст.
    else {Serial.print("Линия не найдена"   );}            // * Выводим текст.
    if( a & bit(1) ){ Serial.print(" 1"); }                // * Выводим номер 1 датчика, если под ним находится линия.
    if( a & bit(2) ){ Serial.print(" 2"); }                // * Выводим номер 2 датчика, если под ним находится линия.
    if( a & bit(3) ){ Serial.print(" 3"); }                // * Выводим номер 3 датчика, если под ним находится линия.
    if( a & bit(4) ){ Serial.print(" 4"); }                // * Выводим номер 4 датчика, если под ним находится линия.
    if( a & bit(5) ){ Serial.print(" 5"); }                // * Выводим номер 5 датчика, если под ним находится линия.
    if( a & bit(6) ){ Serial.print(" 6"); }                // * Выводим номер 6 датчика, если под ним находится линия.
    if( a & bit(7) ){ Serial.print(" 7"); }                // * Выводим номер 7 датчика, если под ним находится линия.
    if( a & bit(8) ){ Serial.print(" 8"); }                // * Выводим номер 8 датчика, если под ним находится линия.
    if( a & bit(9) ){ Serial.print(" 9"); }                // * Выводим номер 9 датчика, если под ним находится линия.
    Serial.println(".");                                   // * Завершаем строку.
}                                                          //