// ПРИМЕР АВТОМАТИЧЕСКОЙ КАЛИБРОВКИ ДАТЧИКОВ ЦВЕТА:        // * Строки со звёздочкой являются необязательными.
                                                           //
// Бампер с 9 датчиками линий с шагом  7мм., FLASH-I2C:    //   https://iarduino.ru/shop/Sensory-Datchiki/bamper-s-9-datchikami-liniy-s-shagom-7mm-flash-i2c.html
// Бампер с 9 датчиками линий с шагом 14мм., FLASH-I2C:    //   https://iarduino.ru/shop/Expansion-payments/bamper-s-7-datchikami-liniy-i2c---flash.html
// Информация о подключении модулей к шине I2C:            //   https://wiki.iarduino.ru/page/i2c_connection/
// Информация о модуле и описание библиотеки:              //   https://wiki.iarduino.ru/page/line-bumper/
                                                           //
#include <Wire.h>                                          //   Подключаем библиотеку для работы с аппаратной шиной I2C, до подключения библиотеки iarduino_I2C_Bumper.
#include <iarduino_I2C_Bumper.h>                           //   Подключаем библиотеку для работы с бампером I2C-flash.
iarduino_I2C_Bumper bum(0x09);                             //   Создаём объект bum для работы с функциями и методами библиотеки iarduino_I2C_Bumper, указывая адрес модуля на шине I2C.
                                                           //   Если объявить объект без указания адреса (iarduino_I2C_Bumper bum;), то адрес будет найден автоматически.
void setup(){                                              //
//   Инициируем работу:                                    //
     delay(500);                                           // * Ждём завершение переходных процессов связанных с подачей питания.
     Serial.begin(9600);                                   //   Инициируем передачу данных в монитор последовательного порта на скорости 9600 бит/сек.
     while(!Serial){;}                                     // * Ждём завершения инициализации шины UART.
     uint8_t f;                                            //   Объявляем переменную для отслеживания результатов калибровки.
     bum.begin(&Wire); // &Wire1, &Wire2 ...               //   Инициируем работу с бампером, указав ссылку на объект для работы с шиной I2C на которой находится бампер (по умолчанию &Wire).
//   Запускаем калибровку датчиков цвета:                  //   
     Serial.println("Установите бампер над белым фоном");  //
     Serial.println("У Вас есть 5 секунд...\r\n");         //
     delay(5000);                                          // * 
     Serial.println("Запускаем калибровку.");              //
     f = bum.setCalibrationRGB();                          //   Запускаем калибровку датчиков цвета.
     if(f){ Serial.println("Ждите..."); }                  //   Если калибровка запустилась (f==true), то выводим текст.
     else { Serial.println("Ошибка!" ); while(1){;} }      //   Иначе, выводим сообщение об ошибке и завершаем выполнение программы входом в бесконечный цикл while.
//   Ожидаем завершения калибровки:                        //
     do{ f = bum.getCalibrationStageRGB(); delay(100); }   //   Читаем статус выполнения калибровки цвета.
     while( f == BUM_STAGE_READ_COLOR );                   //   Остаёмся в цикле while пока статус равен BUM_STAGE_READ_COLOR - цчтение цвета.
//   Выводим результат выполнения калибровки цвета:        //
     if( f == BUM_STAGE_OFF_OK ){                          //
         Serial.println("Калибровка успешно завершена!");  //
     }else                                                 //
     if( f == BUM_STAGE_OFF_ERR ){                         //
         Serial.println("Калибровка не выполнена!");       //
     }else{                                                //
         Serial.println("Неизвестный результат!");         //
     }                                                     //
     Serial.println();                                     //
//   Выводим коэффициенты коррекции яркости цвета:         //
     if( f == BUM_STAGE_OFF_OK ){                          // *
         Serial.println("Найдены коэффициенты:");          // *
         for(int8_t i=0,r=0,g=0,b=0; i<3; i++){            // * Проходим по 3 датчикам цвета...
             bum.getCalibrationManualRGB(i,&r,&g,&b);      // * Получаем коэффициенты коррекции яркости цвета для i датчика в переменные r,g,b.
             Serial.print("(R=");                          // *
             if(r>0){Serial.print('+');} Serial.print(r);  // * Выводим коэффициент коррекции яркости красного цвета для i датчика.
             Serial.print(", G=");                         // *
             if(g>0){Serial.print('+');} Serial.print(g);  // * Выводим коэффициент коррекции яркости зелёного цвета для i датчика.
             Serial.print(", B=");                         // *
             if(b>0){Serial.print('+');} Serial.print(b);  // * Выводим коэффициент коррекции яркости синего цвета для i датчика.
             Serial.print(") ");                           // *
         }   Serial.println();                             // *
         Serial.println();                                 // *
     }                                                     // *
}                                                          //
                                                           //
void loop(){}                                              //
                                                           //
/*  Автоматическая калибровка цвета:
 *  Запуск выполняется функцией setCalibrationRGB().
 *  Состояние отслеживается функцией getCalibrationStageRGB().
 *  Состояние BUM_STAGE_READ_COLOR - выполняется.
 *  Состояние BUM_STAGE_OFF_OK - успешно завершена.
 *  Состояние BUM_STAGE_OFF_ERR - не выполнена или не выполнялась.
 *  В процесе калибровки модуль находит коэффициенты коррекции яркости цвета, которые можно получить функцией getCalibrationManualRGB().
 *  Вместо автоматической калибровки можно указать коэффициенты коррекции яркости цвета самостоятельно функцией setCalibrationManualRGB().
 */ 