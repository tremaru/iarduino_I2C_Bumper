// Пример быстрого чтения линий под датчиками бампера:     // * Строки со звёздочкой являются необязательными.
                                                           //
#include <Wire.h>                                          // * Подключаем библиотеку для работы с аппаратной шиной I2C.
#include <iarduino_I2C_Bumper.h>                           //   Подключаем библиотеку для работы с бампером I2C-flash.
iarduino_I2C_Bumper bum(0x09);                             //   Объявляем объект bum для работы с функциями и методами библиотеки iarduino_I2C_Bumper, указывая адрес модуля на шине I2C.
                                                           //   Если объявить объект без указания адреса (iarduino_I2C_Bumper bum;), то адрес будет найден автоматически.
void setup(){                                              //
    delay(500);                                            // * Ждём завершение переходных процессов связанных с подачей питания.
    Serial.begin(9600);                                    //   Инициируем передачу данных в монитор последовательного порта на скорости 9600 бит/сек.
    while(!Serial){;}                                      // * Ждём завершения инициализации шины UART.
    bum.begin();                                           //   Инициируем работу с бампером.
}                                                          //
                                                           //
void loop(){                                               //
    uint16_t i = bum.getLineDigital(BUM_LINE_ALL);         //   Читаем состояние сразу всех датчиков. Каждый бит переменной i отвечает за свой датчик (кроме 0 бита).
    if(i){Serial.print("Линия под датчиком:");}            //   Выводим текст.
    else {Serial.print("Линия не найдена"   );}            //   Выводим текст.
    if( i & bit(1) ){ Serial.print(" 1"); }                //   Выводим номер 1 датчика, если под ним находится линия.
    if( i & bit(2) ){ Serial.print(" 2"); }                //   Выводим номер 2 датчика, если под ним находится линия.
    if( i & bit(3) ){ Serial.print(" 3"); }                //   Выводим номер 3 датчика, если под ним находится линия.
    if( i & bit(4) ){ Serial.print(" 4"); }                //   Выводим номер 4 датчика, если под ним находится линия.
    if( i & bit(5) ){ Serial.print(" 5"); }                //   Выводим номер 5 датчика, если под ним находится линия.
    if( i & bit(6) ){ Serial.print(" 6"); }                //   Выводим номер 6 датчика, если под ним находится линия.
    if( i & bit(7) ){ Serial.print(" 7"); }                //   Выводим номер 7 датчика, если под ним находится линия.
    if( i & bit(8) ){ Serial.print(" 8"); }                //   Выводим номер 8 датчика, если под ним находится линия.
    if( i & bit(9) ){ Serial.print(" 9"); }                //   Выводим номер 9 датчика, если под ним находится линия.
    Serial.println(".");                                   //   Завершаем строку.
    delay(200);                                            // * Задержка позволяет медленнее заполнять монитор последовательного порта.
}                                                          //
                                                           //
/*  Данный пример, в отличии от примера «getLineDigital», читает состояние всех датчиков одним запросом,
 *  это значительно ускоряет процесс получения данных от бампера.
 */