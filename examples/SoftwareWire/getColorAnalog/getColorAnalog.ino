// ПРИМЕР ЧТЕНИЯ АНАЛОГОВЫХ ЗНАЧЕНИЙ С ДАТЧИКОВ ЦВЕТА:       // * Строки со звёздочкой являются необязательными.
// Требуется установить библиотеку <iarduino_I2C_Software.h> //   https://iarduino.ru/file/627.html
                                                             //
// Бампер с 9 датчиками линий с шагом  7мм., FLASH-I2C:      //   https://iarduino.ru/shop/Sensory-Datchiki/bamper-s-9-datchikami-liniy-s-shagom-7mm-flash-i2c.html
// Бампер с 9 датчиками линий с шагом 14мм., FLASH-I2C:      //   https://iarduino.ru/shop/Expansion-payments/bamper-s-7-datchikami-liniy-i2c---flash.html
// Информация о подключении модулей к шине I2C:              //   https://wiki.iarduino.ru/page/i2c_connection/
// Информация о модуле и описание библиотеки:                //   https://wiki.iarduino.ru/page/line-bumper/
                                                             //
#include <iarduino_I2C_Software.h>                           //   Подключаем библиотеку для работы с программной шиной I2C, до подключения библиотеки iarduino_I2C_Bumper.
SoftTwoWire sWire(3,4);                                      //   Создаём объект программной шины I2C указав выводы которым будет назначена роль линий: SDA, SCL.
                                                             //
#include <iarduino_I2C_Bumper.h>                             //   Подключаем библиотеку для работы с бампером I2C-flash.
iarduino_I2C_Bumper bum(0x09);                               //   Создаём объект bum для работы с функциями и методами библиотеки iarduino_I2C_Bumper, указывая адрес модуля на шине I2C.
                                                             //   Если объявить объект без указания адреса (iarduino_I2C_Bumper bum;), то адрес будет найден автоматически.
void setup(){                                                //
    delay(500);                                              // * Ждём завершение переходных процессов связанных с подачей питания.
    Serial.begin(9600);                                      //   Инициируем передачу данных в монитор последовательного порта на скорости 9600 бит/сек.
    while(!Serial){;}                                        // * Ждём завершения инициализации шины UART.
    bum.begin(&sWire);                                       //   Инициируем работу с бампером, указав ссылку на объект для работы с шиной I2C на которой находится бампер (по умолчанию &Wire).
}                                                            //
                                                             //
//   Определяем названия доступных цветов:                   //
String t[]={"ЧЕР","БЕЛ","КРА","ЖЕЛ","ЗЕЛ","СИН","ГОЛ","ФИО"};//
                                                             //
void loop(){                                                 //
//   Проходим по 3 датчикам цвета:                           //
     for( uint8_t i=1; i<=3; i++){                           //   i = номер датчика от 1 до 3 включительно.
     //  Получаем аналоговые значения цвета:                 //
         int8_t l, r, g, b;                                  //   Переменные для получения: общей яркости (l), яркости каналов красного (r), зелёного (g) и синего (b).
         bum.getColorAnalog(i, &l,&r,&g,&b);                 //   Читаем аналоговые значения из i датчика цвета.
     //  Определяем цвет по аналоговым значениям:            //
         uint8_t c;                                          //   Номер цвета в массиве t.
         if(         r==15                    ){ c=2; }      //   2 - Красный.
         if(                  g==15           ){ c=4; }      //   4 - Зелёный.
         if(                            b==15 ){ c=5; }      //   5 - Синий.
         if(         r<=12 && g>=13  && b>=13 ){ c=6; }      //   6 - Голубой (зел+син).
         if(         r>=13 && g>=12  && b<=9  ){ c=3; }      //   3 - Жёлтый  (кра+зел).
         if(         r>=13 && g>=2*b && b<=9  ){ c=3; }      //   3 - Жёлтый  (кра+зел).
         if(         r>=13 && g<=12  && b>=13 ){ c=7; }      //   7 - Фиолето (кра+син).
         if( l>=4 && r>=11 && g>=11  && b>=11 ){ c=1; }      //   1 - Белый   (кра+зел+син).
         if( l<=3 && r>=11 && g>=11  && b>=11 ){ c=0; }      //   0 - Чёрный  (кра+зел+син).
         if( l>=14                            ){ c=1; }      //   1 - Белый   (высокая яркость).
         if( l==0                             ){ c=0; }      //   0 - Чёрный  (низкая яркость).
     //  Выводим оттенок (темный/светлый):                   //
         if( c>1 && l>=8 ){ Serial.print( "СВ." ); }         //   Цвет светлый.
         if( c>1 && l<=4 ){ Serial.print( "Т."  ); }         //   Цвет тёмный.
     //  Выводим найденный цвет:                             //
         Serial.print( t[c] );                               //   Выводим цвет из массива t под номером c.
         Serial.print( ", " );                               //   Выводим запятую между цветами.
     }                                                       //
     Serial.println();                                       //
     delay(200);                                             // * Задержка вывода цвета в монитор последовательного порта.
}                                                            //

/*  Алгоритм преобразования аналоговых значений в цвет
 *  подбирается экспериментально, нужно учитывать
 *  освещение и высоту бампера над трассой. 
 *  Перед созданием алгоритма нужно выполнить калибровку
 *  датчиков цвета кнопкой или функцией setCalibrationRGB().
 *  При создании алгоритма рекомендуется выводить значения
 *  l, r, g, b, в монитор последовательного порта.
 *  В примере getColorDigital описан более простой вариант
 *  получения цвета с бампера.
 */
